## sample.yaml
```
sample:
  description: Designing Low Power Bluetooth LE devices Lesson 3 Exercise 2
  name: Low Power Bluetooth LE devices - Lesson 3 Exercise 2 

common: 
    sysbuild: true
    build_only: true
    skip: true

    integration_platforms:
      - nrf54l15dk/nrf54l15/cpuapp
      - nrf54l15dk/nrf54l10/cpuapp
      - nrf54l15dk/nrf54l05/cpuapp
      - nrf54lm20dk/nrf54lm20a/cpuapp
      - nrf54lm20dk/nrf54lm20b/cpuapp
      - nrf54ls05dk/nrf54ls05a/cpuapp
      - nrf54ls05dk/nrf54ls05b/cpuapp
      - nrf54lv10dk/nrf54lv10a/cpuapp
    platform_allow:
      - nrf54l15dk/nrf54l15/cpuapp
      - nrf54l15dk/nrf54l10/cpuapp
      - nrf54l15dk/nrf54l05/cpuapp
      - nrf54lm20dk/nrf54lm20a/cpuapp
      - nrf54lm20dk/nrf54lm20b/cpuapp
      - nrf54ls05dk/nrf54ls05a/cpuapp
      - nrf54ls05dk/nrf54ls05b/cpuapp
      - nrf54lv10dk/nrf54lv10a/cpuapp

tests:
  l3.e2: {} 
  
```

## prj.conf
```kconfig
# STEP 1.1 - Disable serial output and enable the Bluetooth LE stack and libraries
```

## src/main.c
```c
/* STEP 1.2 - Add advertising parameters, enable the Bluetooth stack and start advertising */
#include <zephyr/bluetooth/bluetooth.h>

#define DEVICE_NAME "power" 
/* STEP 2.2 - Set the advertising interval to 100 ms */
//#define ADV_INTERVAL_MS 1000
#define ADV_INTERVAL_MS 100

const struct bt_le_adv_param *adv_params =
	BT_LE_ADV_PARAM(
		BT_LE_ADV_OPT_NONE,
		BT_GAP_MS_TO_ADV_INTERVAL(ADV_INTERVAL_MS),
		BT_GAP_MS_TO_ADV_INTERVAL(ADV_INTERVAL_MS),
		NULL);

const struct bt_data ad[] = {
	BT_DATA_BYTES(BT_DATA_FLAGS, (BT_LE_AD_GENERAL | BT_LE_AD_NO_BREDR)),
	BT_DATA(BT_DATA_NAME_COMPLETE, DEVICE_NAME, sizeof(DEVICE_NAME)),
};
int main(void)
{
	bt_enable(NULL);
	bt_le_adv_start(adv_params, ad, ARRAY_SIZE(ad), NULL, 0);
	return 0;
}
```
