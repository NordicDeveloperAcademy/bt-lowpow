## Kconfig.sysbuild
```
#
# Copyright (c) 2026 Nordic Semiconductor
#
# SPDX-License-Identifier: LicenseRef-Nordic-5-Clause
#

source "${ZEPHYR_BASE}/share/sysbuild/Kconfig"

config NRF_DEFAULT_IPC_RADIO
	default y

config NETCORE_IPC_RADIO_BT_HCI_IPC
	default y
```

## prj.conf
```kconfig
# STEP 4.1 - Turn off the UART logger module and enable support for system power off.
CONFIG_SERIAL=n         # Do not initialize UART logger module
CONFIG_POWEROFF=y       # System OFF library
```

## src/main.c
```c
/* STEP 4 - Turn off the low frequency clock, RAM sections for CRACKEN and ICACHE and enter system off */
#include <stdio.h>
#include <zephyr/kernel.h>
#include <zephyr/sys/poweroff.h>
#include <zephyr/drivers/timer/system_timer.h>

int main(void)
{
	//Turn off GRTC and LF clock:
	//sys_clock_disable();

	//Turn off RAM sections for CRACKEN and ICACHE:
	//NRF_MEMCONF->POWER[1].RET &= ~0xE;

	/* STEP 5 - Increase VDD leakage */
	//NRF_P0->PIN_CNF[4] = 0xD;  // Set P0.04 as output with a pullup to VDD
	//NRF_P0->OUTCLR = 1<<4;     // Set P0.04 output to low (GND)

	//Enter system OFF:
	//sys_poweroff();

	return 0;
}
```
