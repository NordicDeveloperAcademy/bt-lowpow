## CMakeLists.txt
```
#
# Copyright (c) 2018 Nordic Semiconductor
#
# SPDX-License-Identifier: LicenseRef-Nordic-5-Clause
#

cmake_minimum_required(VERSION 3.20.0)

find_package(Zephyr REQUIRED HINTS $ENV{ZEPHYR_BASE})
project(bt-lowpower)

target_sources(app PRIVATE  src/main.c)
```

## sample.yaml
```
sample:
  description: Designing Low Power Bluetooth LE devices Lesson 5 Exercise 1 - Clock Sources
  name: Low Power Bluetooth LE devices - Lesson 5 Exercise 1 
tests:
  l5.e1.sol.clock_sources.lfxo:
    sysbuild: true
    build_only: true
    extra_args: 
      - CONFIG_CLOCK_CONTROL_NRF_K32SRC_RC=n
      - CONFIG_MPSL_PIN_DEBUG=n
    integration_platforms:
      - nrf54l15dk/nrf54l15/cpuapp
      - nrf54lm20dk/nrf54lm20a/cpuapp
      - nrf54lm20dk/nrf54lm20b/cpuapp
      - nrf54ls05dk/nrf54ls05b/cpuapp
      - nrf54lv10dk/nrf54lv10a/cpuapp
      - nrf54lc10dk/nrf54lc10a/cpuapp
    platform_allow:
      - nrf54l15dk/nrf54l15/cpuapp
      - nrf54lm20dk/nrf54lm20a/cpuapp
      - nrf54lm20dk/nrf54lm20b/cpuapp
      - nrf54ls05dk/nrf54ls05b/cpuapp
      - nrf54lv10dk/nrf54lv10a/cpuapp
      - nrf54lc10dk/nrf54lc10a/cpuapp

  l5.e1.sol.clock_sources.lfxo.mpsl_debug:
    sysbuild: true
    build_only: true
    extra_args: 
      - CONFIG_CLOCK_CONTROL_NRF_K32SRC_RC=n
      - CONFIG_MPSL_PIN_DEBUG=y
    integration_platforms:
      - nrf54l15dk/nrf54l15/cpuapp
      - nrf54lm20dk/nrf54lm20a/cpuapp
      - nrf54lm20dk/nrf54lm20b/cpuapp
      - nrf54ls05dk/nrf54ls05b/cpuapp
      - nrf54lv10dk/nrf54lv10a/cpuapp
      - nrf54lc10dk/nrf54lc10a/cpuapp
    platform_allow:
      - nrf54l15dk/nrf54l15/cpuapp
      - nrf54lm20dk/nrf54lm20a/cpuapp
      - nrf54lm20dk/nrf54lm20b/cpuapp
      - nrf54ls05dk/nrf54ls05b/cpuapp
      - nrf54lv10dk/nrf54lv10a/cpuapp
      - nrf54lc10dk/nrf54lc10a/cpuapp

  l5.e1.sol.clock_sources.lfrc:
    sysbuild: true
    build_only: true
    extra_args: 
      - CONFIG_CLOCK_CONTROL_NRF_K32SRC_RC=y
      - CONFIG_MPSL_PIN_DEBUG=n
    integration_platforms:
      - nrf54l15dk/nrf54l15/cpuapp
      - nrf54lm20dk/nrf54lm20a/cpuapp
      - nrf54lm20dk/nrf54lm20b/cpuapp
      - nrf54ls05dk/nrf54ls05b/cpuapp
      - nrf54lv10dk/nrf54lv10a/cpuapp
      - nrf54lc10dk/nrf54lc10a/cpuapp
    platform_allow:
      - nrf54l15dk/nrf54l15/cpuapp
      - nrf54lm20dk/nrf54lm20a/cpuapp
      - nrf54lm20dk/nrf54lm20b/cpuapp
      - nrf54ls05dk/nrf54ls05b/cpuapp
      - nrf54lv10dk/nrf54lv10a/cpuapp
      - nrf54lc10dk/nrf54lc10a/cpuapp


  l5.e1.sol.clock_sources.lfrc.mpsl_debug:
    sysbuild: true
    build_only: true
    extra_args: 
      - CONFIG_CLOCK_CONTROL_NRF_K32SRC_RC=y
      - CONFIG_MPSL_PIN_DEBUG=y
    integration_platforms:
      - nrf54l15dk/nrf54l15/cpuapp
      - nrf54lm20dk/nrf54lm20a/cpuapp
      - nrf54lm20dk/nrf54lm20b/cpuapp
      - nrf54ls05dk/nrf54ls05b/cpuapp
      - nrf54lv10dk/nrf54lv10a/cpuapp
      - nrf54lc10dk/nrf54lc10a/cpuapp
    platform_allow:
      - nrf54l15dk/nrf54l15/cpuapp
      - nrf54lm20dk/nrf54lm20a/cpuapp
      - nrf54lm20dk/nrf54lm20b/cpuapp
      - nrf54ls05dk/nrf54ls05b/cpuapp
      - nrf54lv10dk/nrf54lv10a/cpuapp
      - nrf54lc10dk/nrf54lc10a/cpuapp
```

## prj.conf
```kconfig
#
# Copyright (c) 2018 Nordic Semiconductor
#
# SPDX-License-Identifier: LicenseRef-Nordic-5-Clause
#
CONFIG_NCS_SAMPLES_DEFAULTS=y

CONFIG_BT=y
CONFIG_BT_PERIPHERAL=y
CONFIG_BT_DEVICE_NAME="Nordic_LBS"

# Enable the LBS service
CONFIG_BT_LBS=y
CONFIG_BT_LBS_POLL_BUTTON=n
CONFIG_DK_LIBRARY=y

CONFIG_SYSTEM_WORKQUEUE_STACK_SIZE=2048

#STEP 1.1 Disable serial port
CONFIG_SERIAL=n
CONFIG_CONSOLE=n
CONFIG_UART_CONSOLE=n

#STEP 2.2 Configure connection parameters 
CONFIG_BT_PERIPHERAL_PREF_MIN_INT=800       
CONFIG_BT_PERIPHERAL_PREF_MAX_INT=800
CONFIG_BT_PERIPHERAL_PREF_TIMEOUT=400
CONFIG_BT_GAP_AUTO_UPDATE_CONN_PARAMS=y

#STEP 6.1 Enable MPSL debug
CONFIG_MPSL_PIN_DEBUG=y

#STEP 7.1 Enable internal RC oscillator
#STEP 8.3 Disable internal RC oscillator
#STEP 10.4 Enable internal RC oscillator
CONFIG_CLOCK_CONTROL_NRF_K32SRC_RC=y
```

## boards/nrf54l15dk_nrf54l15_cpuapp.overlay
```dts
&gpio1 {
   // STEP 7 Disable the GPIOTE IN event on pin 13 (button 0) 
 sense-edge-mask = <(1 << 13)>;
};
```

## boards/nrf54lm20dk_nrf54lm20a_cpuapp.overlay
```dts
&gpio1 {
   // STEP 7 Disable the GPIOTE IN event on pin 26 (button 0) 
 sense-edge-mask = <(1 << 26)>;
};
```

## boards/nrf54lm20dk_nrf54lm20b_cpuapp.overlay
```dts
&gpio1 {
   // STEP 7 Disable the GPIOTE IN event on pin 26 (button 0)
 sense-edge-mask = <(1 << 26)>;
};
```

## boards/nrf54ls05dk_nrf54ls05a_cpuapp.overlay
```dts
&gpio1 {
   // STEP 7 Disable the GPIOTE IN event on pin 13 (button 0) 
 sense-edge-mask = <(1 << 13)>;
};
```

## boards/nrf54ls05dk_nrf54ls05b_cpuapp.overlay
```dts
&gpio1 {
   // STEP 7 Disable the GPIOTE IN event on pin 13 (button 0)
 sense-edge-mask = <(1 << 13)>;
};
```

## boards/nrf54lv10dk_nrf54lv10a_cpuapp.overlay
```dts
&gpio1 {
   // STEP 7 Disable the GPIOTE IN event on pin 21 (button 0)
 sense-edge-mask = <(1 << 21)>;
};
```

## src/main.c
```c
/*
 * Copyright (c) 2018 Nordic Semiconductor ASA
 *
 * SPDX-License-Identifier: LicenseRef-Nordic-5-Clause
 */

#include <zephyr/types.h>
#include <stddef.h>
#include <string.h>
#include <errno.h>
#include <zephyr/sys/printk.h>
#include <zephyr/sys/byteorder.h>
#include <zephyr/kernel.h>
#include <zephyr/drivers/gpio.h>
#include <soc.h>

#include <zephyr/bluetooth/bluetooth.h>
#include <zephyr/bluetooth/hci.h>
#include <zephyr/bluetooth/conn.h>
#include <zephyr/bluetooth/uuid.h>
#include <zephyr/bluetooth/gatt.h>

#include <bluetooth/services/lbs.h>

#include <zephyr/settings/settings.h>

#include <dk_buttons_and_leds.h>

#define DEVICE_NAME             CONFIG_BT_DEVICE_NAME
#define DEVICE_NAME_LEN         (sizeof(DEVICE_NAME) - 1)


#define RUN_STATUS_LED          DK_LED1
#define CON_STATUS_LED          DK_LED2
#define RUN_LED_BLINK_INTERVAL  1000

#define USER_LED                DK_LED3

#define USER_BUTTON             DK_BTN1_MSK

/* STEP 8.1 - Define advertising settings */
#define BT_LE_ADV_CONN_100                                                                      \
    BT_LE_ADV_PARAM(BT_LE_ADV_OPT_CONN, BT_GAP_ADV_FAST_INT_MIN_2, BT_GAP_ADV_FAST_INT_MIN_2,  \
            NULL)

static bool app_button_state;
static struct k_work adv_work;

static const struct bt_data ad[] = {
    BT_DATA_BYTES(BT_DATA_FLAGS, (BT_LE_AD_GENERAL | BT_LE_AD_NO_BREDR)),
    BT_DATA(BT_DATA_NAME_COMPLETE, DEVICE_NAME, DEVICE_NAME_LEN),
};

static const struct bt_data sd[] = {
    BT_DATA_BYTES(BT_DATA_UUID128_ALL, BT_UUID_LBS_VAL),
};

static void adv_work_handler(struct k_work *work)
{
    /* STEP 8.2 - Apply defined settings for the advertising process */
    int err = bt_le_adv_start(BT_LE_ADV_CONN_100, ad, ARRAY_SIZE(ad), sd, ARRAY_SIZE(sd));
    if (err) {
        printk("Advertising failed to start (err %d)\n", err);
        return;
    }

    printk("Advertising successfully started\n");
}

static void advertising_start(void)
{
    k_work_submit(&adv_work);
}

static void connected(struct bt_conn *conn, uint8_t err)
{
    if (err) {
        printk("Connection failed, err 0x%02x %s\n", err, bt_hci_err_to_str(err));
        return;
    }

    printk("Connected\n");
}

static void disconnected(struct bt_conn *conn, uint8_t reason)
{
    printk("Disconnected, reason 0x%02x %s\n", reason, bt_hci_err_to_str(reason));
}


static void recycled_cb(void)
{
    printk("Connection object available from previous conn. Disconnect is complete!\n");
    advertising_start();
}

#ifdef CONFIG_BT_LBS_SECURITY_ENABLED
static void security_changed(struct bt_conn *conn, bt_security_t level,
                 enum bt_security_err err)
{
    char addr[BT_ADDR_LE_STR_LEN];

    bt_addr_le_to_str(bt_conn_get_dst(conn), addr, sizeof(addr));

    if (!err) {
        printk("Security changed: %s level %u\n", addr, level);
    } else {
        printk("Security failed: %s level %u err %d %s\n", addr, level, err,
               bt_security_err_to_str(err));
    }
}
#endif

BT_CONN_CB_DEFINE(conn_callbacks) = {
    .connected        = connected,
    .disconnected     = disconnected,
    .recycled         = recycled_cb,
#ifdef CONFIG_BT_LBS_SECURITY_ENABLED
    .security_changed = security_changed,
#endif
};

#if defined(CONFIG_BT_LBS_SECURITY_ENABLED)
static void auth_passkey_display(struct bt_conn *conn, unsigned int passkey)
{
    char addr[BT_ADDR_LE_STR_LEN];

    bt_addr_le_to_str(bt_conn_get_dst(conn), addr, sizeof(addr));

    printk("Passkey for %s: %06u\n", addr, passkey);
}

static void auth_cancel(struct bt_conn *conn)
{
    char addr[BT_ADDR_LE_STR_LEN];

    bt_addr_le_to_str(bt_conn_get_dst(conn), addr, sizeof(addr));

    printk("Pairing cancelled: %s\n", addr);
}

static void pairing_complete(struct bt_conn *conn, bool bonded)
{
    char addr[BT_ADDR_LE_STR_LEN];

    bt_addr_le_to_str(bt_conn_get_dst(conn), addr, sizeof(addr));

    printk("Pairing completed: %s, bonded: %d\n", addr, bonded);
}

static void pairing_failed(struct bt_conn *conn, enum bt_security_err reason)
{
    char addr[BT_ADDR_LE_STR_LEN];

    bt_addr_le_to_str(bt_conn_get_dst(conn), addr, sizeof(addr));

    printk("Pairing failed conn: %s, reason %d %s\n", addr, reason,
           bt_security_err_to_str(reason));
}

static struct bt_conn_auth_cb conn_auth_callbacks = {
    .passkey_display = auth_passkey_display,
    .cancel = auth_cancel,
};

static struct bt_conn_auth_info_cb conn_auth_info_callbacks = {
    .pairing_complete = pairing_complete,
    .pairing_failed = pairing_failed
};
#else
static struct bt_conn_auth_cb conn_auth_callbacks;
static struct bt_conn_auth_info_cb conn_auth_info_callbacks;
#endif

static void app_led_cb(bool led_state)
{

}

static bool app_button_cb(void)
{
    return app_button_state;
}

static struct bt_lbs_cb lbs_callbacs = {
    .led_cb    = app_led_cb,
    .button_cb = app_button_cb,
};


int main(void)
{
    int err;

    printk("Starting Bluetooth Peripheral LBS sample\n");

    if (IS_ENABLED(CONFIG_BT_LBS_SECURITY_ENABLED)) {
        err = bt_conn_auth_cb_register(&conn_auth_callbacks);
        if (err) {
            printk("Failed to register authorization callbacks.\n");
            return 0;
        }

        err = bt_conn_auth_info_cb_register(&conn_auth_info_callbacks);
        if (err) {
            printk("Failed to register authorization info callbacks.\n");
            return 0;
        }
    }

    err = bt_enable(NULL);
    if (err) {
        printk("Bluetooth init failed (err %d)\n", err);
        return 0;
    }

    printk("Bluetooth initialized\n");

    if (IS_ENABLED(CONFIG_SETTINGS)) {
        settings_load();
    }

    err = bt_lbs_init(&lbs_callbacs);
    if (err) {
        printk("Failed to init LBS (err:%d)\n", err);
        return 0;
    }

    k_work_init(&adv_work, adv_work_handler);
    advertising_start();

    return 0;
}
```
