## l6/l6_e2/Kconfig
```kconfig
source "Kconfig.zephyr"

menu "Lesson 6 Exercise 2 config"

config USE_TIMER_TRIGGER
    bool "Use timer workflow trigger"
    default n

config USE_PPI_WORKFLOW
    bool "Use PPI workflow"
    default n 

config GPIO_EVENT_PERIOD_US
    int "GPIO event period in microseconds"
    default 50000

config GPIO_EVENTS_CNT
    int "Number of GPIO events in one cycle"
    default 2

config PWM_OUTPUT_PERIOD_US
    int "PWM output period in microseconds"
    default 250000


endmenu
```

## l7/l7_e1/sample.yaml
```yaml
sample:
  description: Designing Low Power Bluetooth LE devices Lesson 7 Exercise 1 - Setting Up the Memfault SDK
  name: Low Power Bluetooth LE devices - Lesson 7 Exercise 1

common:
    sysbuild: true
    build_only: true
    skip: true

    integration_platforms:
      - nrf54l15dk/nrf54l15/cpuapp
      - nrf54l15dk/nrf54l10/cpuapp
      - nrf54l15dk/nrf54l05/cpuapp
      - nrf54lm20dk/nrf54lm20a/cpuapp
    platform_allow:
      - nrf54l15dk/nrf54l15/cpuapp
      - nrf54l15dk/nrf54l10/cpuapp
      - nrf54l15dk/nrf54l05/cpuapp
      - nrf54lm20dk/nrf54lm20a/cpuapp

tests:
  l7.e1: {}
```

## l7/l7_e1_sol/sample.yaml
```yaml
sample:
  description: Designing Low Power Bluetooth LE devices Lesson 7 Exercise 1 Solution - Setting Up the Memfault SDK
  name: Low Power Bluetooth LE devices - Lesson 7 Exercise 1 Solution

common:
    sysbuild: true
    build_only: true
    skip: true

    integration_platforms:
      - nrf54l15dk/nrf54l15/cpuapp
      - nrf54l15dk/nrf54l10/cpuapp
      - nrf54l15dk/nrf54l05/cpuapp
      - nrf54lm20dk/nrf54lm20a/cpuapp
    platform_allow:
      - nrf54l15dk/nrf54l15/cpuapp
      - nrf54l15dk/nrf54l10/cpuapp
      - nrf54l15dk/nrf54l05/cpuapp
      - nrf54lm20dk/nrf54lm20a/cpuapp

tests:
  l7_e1.sol: {}
```

## l7/l7_e4/Kconfig
```kconfig
osource "$(ZEPHYR_NRF_MODULE_DIR)/samples/common/mcumgr_bt_ota_dfu/Kconfig"

config SETTINGS
	default y

config ZMS
	default y if (SOC_FLASH_NRF_RRAM || SOC_FLASH_NRF_MRAM)

config NVS
	default y if !(SOC_FLASH_NRF_RRAM || SOC_FLASH_NRF_MRAM)

source "Kconfig.zephyr"
```
