## CMakeLists.txt
```
cmake_minimum_required(VERSION 3.20.0)

find_package(Zephyr REQUIRED HINTS $ENV{ZEPHYR_BASE})

project(l5_e3)

target_sources(app PRIVATE main.c timer.c pattern.c pwm.c)
```

## Kconfig
```
source "Kconfig.zephyr"

menu "Lesson 5 Exercise 3 config"


choice GPIO_PATTERN
    bool "GPIO pattern choice"
    default PATTERN_DISABLED

config PATTERN_DISABLED
    bool "NO_PATTERN"

config PATTERN_TIMER_W_CPU
    bool "Pattern timer with CPU workflow"

config PATTERN_PWM_SIMPLE
    bool "Pattern PWM with CPU workflow"

config PATTERN_PWM_COMPLEX
    bool "Pattern PWM with DMA workflow"

endchoice

endmenu
```

## sample.yaml
```
sample:
  description: Designing Low Power Bluetooth LE devices Lesson 5 Exercise 3 - Memory Retention
  name: Low Power Bluetooth LE devices - Lesson 5 Exercise 3 


common: 
    sysbuild: true
    build_only: true
    skip: true
    sysbuild: true

    integration_platforms:
      - nrf54l15dk/nrf54l15/cpuapp
      - nrf54l15dk/nrf54l10/cpuapp
      - nrf54l15dk/nrf54l05/cpuapp
      - nrf54lm20dk/nrf54lm20a/cpuapp
      - nrf54lm20dk/nrf54lm20b/cpuapp
      - nrf54ls05dk/nrf54ls05b/cpuapp
      - nrf54lv10dk/nrf54lv10a/cpuapp
      - nrf54lc10dk/nrf54lc10a/cpuapp
    platform_allow:
      - nrf54l15dk/nrf54l15/cpuapp
      - nrf54l15dk/nrf54l10/cpuapp
      - nrf54l15dk/nrf54l05/cpuapp
      - nrf54lm20dk/nrf54lm20a/cpuapp
      - nrf54lm20dk/nrf54lm20b/cpuapp
      - nrf54ls05dk/nrf54ls05b/cpuapp
      - nrf54lv10dk/nrf54lv10a/cpuapp
      - nrf54lc10dk/nrf54lc10a/cpuapp

tests:
  l5.e3: {}
```

## prj.conf
```kconfig
#
# Copyright (c) 2018 Nordic Semiconductor
#
# SPDX-License-Identifier: LicenseRef-Nordic-5-Clause
#
CONFIG_NCS_SAMPLES_DEFAULTS=y

CONFIG_BT=y
CONFIG_BT_PERIPHERAL=y
CONFIG_BT_DEVICE_NAME="Nordic_LBS"

# Enable the LBS service
CONFIG_BT_LBS=y
CONFIG_BT_LBS_POLL_BUTTON=n
CONFIG_DK_LIBRARY=y
CONFIG_DEBUG_OPTIMIZATIONS=y

CONFIG_SYSTEM_WORKQUEUE_STACK_SIZE=2048


CONFIG_BT_PERIPHERAL_PREF_MIN_INT=800       
CONFIG_BT_PERIPHERAL_PREF_MAX_INT=800
CONFIG_BT_PERIPHERAL_PREF_TIMEOUT=400
CONFIG_BT_GAP_AUTO_UPDATE_CONN_PARAMS=y

CONFIG_SERIAL=n

# STEP 5.1 Enable RAM power down library 
```

## src/main.c
```c
/*
 * Copyright (c) 2018 Nordic Semiconductor ASA
 *
 * SPDX-License-Identifier: LicenseRef-Nordic-5-Clause
 */

#include <zephyr/types.h>
#include <stddef.h>
#include <string.h>
#include <errno.h>
#include <zephyr/sys/printk.h>
#include <zephyr/sys/byteorder.h>
#include <zephyr/kernel.h>
#include <zephyr/drivers/gpio.h>
#include <soc.h>

#include <zephyr/bluetooth/bluetooth.h>
#include <zephyr/bluetooth/hci.h>
#include <zephyr/bluetooth/conn.h>
#include <zephyr/bluetooth/uuid.h>
#include <zephyr/bluetooth/gatt.h>

#include <bluetooth/services/lbs.h>

#include <zephyr/settings/settings.h>

#include <dk_buttons_and_leds.h>

#if defined (CONFIG_RAM_POWER_DOWN_LIBRARY)
#include <ram_pwrdn.h>
#endif

/* STEP 4.1 - Define memory bitmask */

#define DEVICE_NAME             CONFIG_BT_DEVICE_NAME
#define DEVICE_NAME_LEN         (sizeof(DEVICE_NAME) - 1)


#define RUN_STATUS_LED          DK_LED1
#define CON_STATUS_LED          DK_LED2
#define RUN_LED_BLINK_INTERVAL  1000

#define USER_LED                DK_LED3

#define USER_BUTTON             DK_BTN1_MSK

#define BT_LE_ADV_CONN_1000                                                                      \
    BT_LE_ADV_PARAM(BT_LE_ADV_OPT_CONN, BT_GAP_ADV_SLOW_INT_MIN, BT_GAP_ADV_SLOW_INT_MIN,  \
            NULL)

static bool app_button_state;
static struct k_work adv_work;

static const struct bt_data ad[] = {
    BT_DATA_BYTES(BT_DATA_FLAGS, (BT_LE_AD_GENERAL | BT_LE_AD_NO_BREDR)),
    BT_DATA(BT_DATA_NAME_COMPLETE, DEVICE_NAME, DEVICE_NAME_LEN),
};

static const struct bt_data sd[] = {
    BT_DATA_BYTES(BT_DATA_UUID128_ALL, BT_UUID_LBS_VAL),
};

static void adv_work_handler(struct k_work *work)
{
    int err = bt_le_adv_start(BT_LE_ADV_CONN_1000, ad, ARRAY_SIZE(ad), sd, ARRAY_SIZE(sd));

    if (err) {
        printk("Advertising failed to start (err %d)\n", err);
        return;
    }

    printk("Advertising successfully started\n");
}

static void advertising_start(void)
{
    k_work_submit(&adv_work);
}

static void connected(struct bt_conn *conn, uint8_t err)
{
    if (err) {
        printk("Connection failed, err 0x%02x %s\n", err, bt_hci_err_to_str(err));
        return;
    }

    printk("Connected\n");
}

static void disconnected(struct bt_conn *conn, uint8_t reason)
{
    printk("Disconnected, reason 0x%02x %s\n", reason, bt_hci_err_to_str(reason));
}


static void recycled_cb(void)
{
    printk("Connection object available from previous conn. Disconnect is complete!\n");
    advertising_start();
}

#ifdef CONFIG_BT_LBS_SECURITY_ENABLED
static void security_changed(struct bt_conn *conn, bt_security_t level,
                 enum bt_security_err err)
{
    char addr[BT_ADDR_LE_STR_LEN];

    bt_addr_le_to_str(bt_conn_get_dst(conn), addr, sizeof(addr));

    if (!err) {
        printk("Security changed: %s level %u\n", addr, level);
    } else {
        printk("Security failed: %s level %u err %d %s\n", addr, level, err,
               bt_security_err_to_str(err));
    }
}
#endif

BT_CONN_CB_DEFINE(conn_callbacks) = {
    .connected        = connected,
    .disconnected     = disconnected,
    .recycled         = recycled_cb,
#ifdef CONFIG_BT_LBS_SECURITY_ENABLED
    .security_changed = security_changed,
#endif
};

#if defined(CONFIG_BT_LBS_SECURITY_ENABLED)
static void auth_passkey_display(struct bt_conn *conn, unsigned int passkey)
{
    char addr[BT_ADDR_LE_STR_LEN];

    bt_addr_le_to_str(bt_conn_get_dst(conn), addr, sizeof(addr));

    printk("Passkey for %s: %06u\n", addr, passkey);
}

static void auth_cancel(struct bt_conn *conn)
{
    char addr[BT_ADDR_LE_STR_LEN];

    bt_addr_le_to_str(bt_conn_get_dst(conn), addr, sizeof(addr));

    printk("Pairing cancelled: %s\n", addr);
}

static void pairing_complete(struct bt_conn *conn, bool bonded)
{
    char addr[BT_ADDR_LE_STR_LEN];

    bt_addr_le_to_str(bt_conn_get_dst(conn), addr, sizeof(addr));

    printk("Pairing completed: %s, bonded: %d\n", addr, bonded);
}

static void pairing_failed(struct bt_conn *conn, enum bt_security_err reason)
{
    char addr[BT_ADDR_LE_STR_LEN];

    bt_addr_le_to_str(bt_conn_get_dst(conn), addr, sizeof(addr));

    printk("Pairing failed conn: %s, reason %d %s\n", addr, reason,
           bt_security_err_to_str(reason));
}

static struct bt_conn_auth_cb conn_auth_callbacks = {
    .passkey_display = auth_passkey_display,
    .cancel = auth_cancel,
};

static struct bt_conn_auth_info_cb conn_auth_info_callbacks = {
    .pairing_complete = pairing_complete,
    .pairing_failed = pairing_failed
};
#else
static struct bt_conn_auth_cb conn_auth_callbacks;
static struct bt_conn_auth_info_cb conn_auth_info_callbacks;
#endif

static void app_led_cb(bool led_state)
{

}

static bool app_button_cb(void)
{
    return app_button_state;
}

static struct bt_lbs_cb lbs_callbacs = {
    .led_cb    = app_led_cb,
    .button_cb = app_button_cb,
};


int main(void)
{
    int err;

    /* STEP 4.2 Disable unused memory blocks */


    /* STEP 5.3 Power down unused RAM */

    
    printk("Starting Bluetooth Peripheral LBS sample\n");

    if (IS_ENABLED(CONFIG_BT_LBS_SECURITY_ENABLED)) {
        err = bt_conn_auth_cb_register(&conn_auth_callbacks);
        if (err) {
            printk("Failed to register authorization callbacks.\n");
            return 0;
        }

        err = bt_conn_auth_info_cb_register(&conn_auth_info_callbacks);
        if (err) {
            printk("Failed to register authorization info callbacks.\n");
            return 0;
        }
    }

    err = bt_enable(NULL);
    if (err) {
        printk("Bluetooth init failed (err %d)\n", err);
        return 0;
    }

    printk("Bluetooth initialized\n");

    if (IS_ENABLED(CONFIG_SETTINGS)) {
        settings_load();
    }

    err = bt_lbs_init(&lbs_callbacs);
    if (err) {
        printk("Failed to init LBS (err:%d)\n", err);
        return 0;
    }

    k_work_init(&adv_work, adv_work_handler);
    advertising_start();

    return 0;
}
```

## src/timer.c
```c
#include <nrfx_timer.h>
#include <zephyr/drivers/gpio.h>
#include <hal/nrf_gpio.h>
#include <helpers/nrfx_gppi.h>
#include <nrfx_gpiote.h>
#include "helpers.h"


/** @brief TIMER instance used in the example. */
#define TIMER_INST_IDX              20
#define TIMER_COMPARE_CH0_VALUE     (1000)
#define TIMER_FREQUENCY_MHZ         (16)

static nrfx_timer_t timer_inst = NRFX_TIMER_INSTANCE(NRF_TIMER_INST_GET(TIMER_INST_IDX));

static uint32_t _pattern_size;
static const uint16_t * _pattern_ptr;

#define GPPI_GPIOTE_INST_IDX 20
static nrfx_gpiote_t gpiote_inst = NRFX_GPIOTE_INSTANCE(NRF_GPIOTE_INST_GET(GPPI_GPIOTE_INST_IDX));

#define LED1_PIN NRF_GPIO_PIN_MAP(1,10)

/**
 * @brief Function for handling TIMER driver events. 
 *
 * @param[in] event_type Timer event.
 * @param[in] p_context  General purpose parameter set during initialization of
 *                       the timer. This parameter can be used to pass
 *                       additional information to the handler function, for
 *                       example, the timer ID.
 */
static void timer_handler(nrf_timer_event_t event_type, void * p_context)
{
    if(event_type == NRF_TIMER_EVENT_COMPARE0)
    {
        static uint32_t index =1;
        timer_inst.p_reg->CC[NRF_TIMER_CC_CHANNEL1] = _pattern_ptr[index];
        index++;

        if(index >= _pattern_size )
        {
            index = 0;
        }
    }
}

static void init_timer_ddpi_output( void )
{
    int status =nrfx_gpiote_init(&gpiote_inst, NRFX_GPIOTE_DEFAULT_CONFIG_IRQ_PRIORITY);
    uint8_t out_channel;
    nrfx_gppi_handle_t led_set, led_clr;

    NRFX_ASSERT(status == 0);

    status = nrfx_gpiote_channel_alloc(&gpiote_inst, &out_channel);
    NRFX_ASSERT(status == 0);

    static const nrfx_gpiote_output_config_t output_config =
    {
    .drive = NRF_GPIO_PIN_S0S1,
    .input_connect = NRF_GPIO_PIN_INPUT_DISCONNECT,
    .pull = NRF_GPIO_PIN_NOPULL,
    };

    const nrfx_gpiote_task_config_t task_config =
    {
    .task_ch = out_channel,
    .polarity = NRF_GPIOTE_POLARITY_TOGGLE,
    .init_val = NRF_GPIOTE_INITIAL_VALUE_LOW,
    };

    status = nrfx_gpiote_output_configure(&gpiote_inst, LED1_PIN, &output_config, &task_config);
    NRFX_ASSERT(status == 0);

    nrfx_gpiote_out_task_enable(&gpiote_inst, LED1_PIN);

    status = nrfx_gppi_conn_alloc(
            nrfx_timer_compare_event_address_get(&timer_inst, NRF_TIMER_CC_CHANNEL1),
            nrfx_gpiote_set_task_address_get(&gpiote_inst, LED1_PIN),
        &led_set);
        NRFX_ASSERT(status == 0);

        status = nrfx_gppi_conn_alloc(
            nrfx_timer_compare_event_address_get(&timer_inst, NRF_TIMER_CC_CHANNEL0),
            nrfx_gpiote_clr_task_address_get(&gpiote_inst, LED1_PIN),
        &led_clr);
        NRFX_ASSERT(status == 0);

    nrfx_gppi_conn_enable(led_set);
    nrfx_gppi_conn_enable(led_clr);
    
}

/**
 * @brief Function for application main entry.
 *
 * @return Nothing.
 */
int init_timer( const uint16_t * pattern_ptr, uint32_t pattern_size, bool enable_pattern)
{
    int status;
    (void)status;
    NRFX_ASSERT(pattern_ptr != NULL);
    NRFX_ASSERT(pattern_size > 0);
    _pattern_ptr =  pattern_ptr;
    _pattern_size = pattern_size;

    IRQ_CONNECT(NRFX_IRQ_NUMBER_GET(NRF_TIMER_INST_GET(TIMER_INST_IDX)), IRQ_PRIO_LOWEST,
                nrfx_timer_irq_handler, &timer_inst, TIMER_INST_IDX);

    nrfx_timer_config_t config = NRFX_TIMER_DEFAULT_CONFIG(NRFX_MHZ_TO_HZ(TIMER_FREQUENCY_MHZ));
    config.bit_width = NRF_TIMER_BIT_WIDTH_32;
    config.p_context = "Some context";

    status = nrfx_timer_init(&timer_inst, &config, enable_pattern ? timer_handler : NULL);
    NRFX_ASSERT(status == 0);

    nrfx_timer_clear(&timer_inst);

    nrfx_timer_extended_compare(&timer_inst, NRF_TIMER_CC_CHANNEL0, TIMER_COMPARE_CH0_VALUE, NRF_TIMER_SHORT_COMPARE0_CLEAR_MASK, enable_pattern? true : false);

    nrfx_timer_compare(&timer_inst, NRF_TIMER_CC_CHANNEL1, _pattern_ptr[0], enable_pattern? true : false);

    if(enable_pattern)
    {
       init_timer_ddpi_output();
    }

    nrfx_timer_enable(&timer_inst);

    return 0;
}

/** @} */
```
