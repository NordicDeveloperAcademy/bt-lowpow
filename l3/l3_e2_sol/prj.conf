## sample.yaml
```
sample:
  description: Designing Low Power Bluetooth LE devices Lesson 3 Exercise 2
  name: Low Power Bluetooth LE devices - Lesson 3 Exercise 2 

common: 
    sysbuild: true
    build_only: true
    skip: true

    integration_platforms:
      - nrf54l15dk/nrf54l15/cpuapp
      - nrf54l15dk/nrf54l10/cpuapp
      - nrf54l15dk/nrf54l05/cpuapp
      - nrf54lm20dk/nrf54lm20a/cpuapp
      - nrf54lm20dk/nrf54lm20b/cpuapp
      - nrf54ls05dk/nrf54ls05a/cpuapp
      - nrf54ls05dk/nrf54ls05b/cpuapp
      - nrf54lv10dk/nrf54lv10a/cpuapp
    platform_allow:
      - nrf54l15dk/nrf54l15/cpuapp
      - nrf54l15dk/nrf54l10/cpuapp
      - nrf54l15dk/nrf54l05/cpuapp
      - nrf54lm20dk/nrf54lm20a/cpuapp
      - nrf54lm20dk/nrf54lm20b/cpuapp
      - nrf54ls05dk/nrf54ls05a/cpuapp
      - nrf54ls05dk/nrf54ls05b/cpuapp
      - nrf54lv10dk/nrf54lv10a/cpuapp

tests:
  l3.e2.sol: {} 
  
```

## prj.conf
```kconfig
# STEP 1.1 - Disable serial output and enable the Bluetooth LE stack and libraries
CONFIG_SERIAL=n         # Do not initialize UART logger module
CONFIG_BT=y             # Bluetooth LE stack and libraries
```

## src/main.c
```c
/* STEP 1.2 - Add advertising parameters, enable the Bluetooth stack and start advertising */
```
